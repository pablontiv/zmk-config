## config/boards/shields/pones_corne/Kconfig.defconfig
```kconfig
# SPDX-License-Identifier: MIT

if SHIELD_PONES_CORNE_DONGLE

config ZMK_KEYBOARD_NAME
    default "Pones Corne"

config ZMK_SPLIT_ROLE_CENTRAL
    default y

endif

if SHIELD_PONES_CORNE_LEFT || SHIELD_PONES_CORNE_RIGHT || SHIELD_PONES_CORNE_DONGLE

config ZMK_SPLIT
    default y

config ZMK_POINTING
    default y

endif

if SHIELD_PONES_CORNE_LEFT || SHIELD_PONES_CORNE_RIGHT

config ZMK_SPLIT_ROLE_CENTRAL
    default n

endif

if SHIELD_PONES_CORNE_RIGHT

config ZMK_DISPLAY
    default n

config I2C
    default y

endif

# Left-half 128x32 SSD1306 OLED, as in the previous working firmware.
if SHIELD_PONES_CORNE_LEFT

config ZMK_DISPLAY
    default y

if ZMK_DISPLAY

config I2C
    default y

config SSD1306
    default y

endif # ZMK_DISPLAY

if LVGL

config LV_Z_VDB_SIZE
    default 64

config LV_DPI_DEF
    default 148

config LV_Z_BITS_PER_PIXEL
    default 1

choice LV_COLOR_DEPTH
    default LV_COLOR_DEPTH_1
endchoice

endif # LVGL

endif
```

## config/boards/shields/pones_corne/Kconfig.shield
```kconfig
# SPDX-License-Identifier: MIT

config SHIELD_PONES_CORNE_LEFT
    def_bool $(shields_list_contains,pones_corne_left)

config SHIELD_PONES_CORNE_RIGHT
    def_bool $(shields_list_contains,pones_corne_right)

config SHIELD_PONES_CORNE_DONGLE
    def_bool $(shields_list_contains,pones_corne_dongle)
```

## config/west.yml
```yaml
manifest:
  remotes:
    - name: zmkfirmware
      url-base: https://github.com/zmkfirmware
  projects:
    - name: zmk
      remote: zmkfirmware
      revision: edf5c0814fd3ea202e43aad2d68fd32e882a518c # v0.3.0
      import: app/west.yml
    - name: cirque-input-module
      url: https://github.com/petejohanson/cirque-input-module
      revision: 0de55f36bc720b5be3d8880dc856d4d78baf5214
  self:
    path: config
```
