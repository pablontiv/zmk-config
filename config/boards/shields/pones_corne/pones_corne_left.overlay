/* SPDX-License-Identifier: MIT */

#include "pones_corne_matrix.dtsi"

&kscan0 {
    /* Stock inner five columns, left-to-right; D21 is omitted entirely. */
    col-gpios = <&pro_micro 20 GPIO_ACTIVE_HIGH>,
                <&pro_micro 19 GPIO_ACTIVE_HIGH>,
                <&pro_micro 18 GPIO_ACTIVE_HIGH>,
                <&pro_micro 15 GPIO_ACTIVE_HIGH>,
                <&pro_micro 14 GPIO_ACTIVE_HIGH>;
};

